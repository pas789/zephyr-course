## app/boards/from_scratch/Kconfig.from_scratch
```kconfig
# Copyright (c) 2022 Zephyr Project members and individual contributors
# SPDX-License-Identifier: Apache-2.0

config BOARD_FROM_SCRATCH
	select SOC_NRF52840_QIAA
```

## app/boards/from_scratch/board.yml
```yaml
board:
  name: from_scratch
  full_name: From Scratch
  vendor: pas
  socs:
  # Physical nRF52840 SoC on PCA10056
  - name: nrf52840
```

## app/boards/my_custom_board/board.yml
```yaml
board:
  name: my_custom_board
  full_name: My Custom Board
  vendor: pas
  socs:
  # Physical nRF52840 SoC on PCA10056
  - name: nrf52840
```

## app/drivers/pas_driver/Kconfig
```kconfig
menuconfig PAS_DRIVER
    bool "On-board led sensor driver"
    default y
    help
        Enable the custom driver for on-board led sensor driver
```

## dts/bindings/pas,driver.yaml
```yaml
description: On-board led sensor driver
compatible: "pas,driver"
include: base.yaml
```
